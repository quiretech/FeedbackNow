## epd_test/custom_driver_module/drivers/display/custom_epd1683/Kconfig
```kconfig
config CUSTOM_EPD1683
	bool "Custom EPD1683 display driver"
	default n
	depends on DISPLAY && SPI && GPIO
	help
	  Enable EPD1683 display driver support.
```

## epd_test/custom_driver_module/drivers/dts/bindings/display/custom-epd1683.yaml
```yaml
description: SSD1683 EPD display controller
compatible: "custom,epd1683"
include:
  - display-controller.yaml
  - spi-device.yaml
properties:
  reset-gpios:
    type: phandle-array
    description: |
      GPIO connected to RESET signal.
    required: true
  busy-gpios:
    type: phandle-array
    description: |
      GPIO connected to the BUSY signal.
    required: true
  dc-gpios:
    type: phandle-array
    description: |
      DC enable pin.
    required: true
  height:
    type: int
    required: true
    description: |
      Height of the panel driven by the controller, with the units in pixels.
  width:
    type: int
    required: true
    description: |
      Width of the panel driven by the controller, with the units in pixels.
```

## v1.1/app/build_1/Kconfig/arch/Kconfig
```kconfig
# Load Zephyr Arch Kconfig descriptions.
osource "/home/jpandya/ncs/v3.0.2/zephyr/arch/x86/Kconfig"
osource "/home/jpandya/ncs/v3.0.2/zephyr/arch/xtensa/Kconfig"
osource "/home/jpandya/ncs/v3.0.2/zephyr/arch/sparc/Kconfig"
osource "/home/jpandya/ncs/v3.0.2/zephyr/arch/riscv/Kconfig"
osource "/home/jpandya/ncs/v3.0.2/zephyr/arch/posix/Kconfig"
osource "/home/jpandya/ncs/v3.0.2/zephyr/arch/nios2/Kconfig"
osource "/home/jpandya/ncs/v3.0.2/zephyr/arch/mips/Kconfig"
osource "/home/jpandya/ncs/v3.0.2/zephyr/arch/arm64/Kconfig"
osource "/home/jpandya/ncs/v3.0.2/zephyr/arch/arm/Kconfig"
osource "/home/jpandya/ncs/v3.0.2/zephyr/arch/arc/Kconfig"
```

## v1.1/app/build_1/app/Kconfig/boards/Kconfig
```kconfig
# Load Zephyr board Kconfig descriptions.
osource "/home/jpandya/ncs/v3.0.2/zephyr/boards/nordic/nrf52840dk/Kconfig"
```

## v1.1/app/build_1/app/Kconfig/boards/Kconfig.defconfig
```kconfig
# Load Zephyr board defconfig descriptions.
osource "/home/jpandya/ncs/v3.0.2/zephyr/boards/nordic/nrf52840dk/Kconfig.defconfig"
```

## v1.1/app/build_1/app/Kconfig/soc/Kconfig
```kconfig
# Load Zephyr SoC Kconfig descriptions.
osource "/home/jpandya/ncs/v3.0.2/zephyr/soc/xlnx/zynqmp/Kconfig"
osource "/home/jpandya/ncs/v3.0.2/zephyr/soc/xlnx/zynq7000/Kconfig"
osource "/home/jpandya/ncs/v3.0.2/zephyr/soc/xen/Kconfig"
osource "/home/jpandya/ncs/v3.0.2/zephyr/soc/wch/ch32v00x/Kconfig"
osource "/home/jpandya/ncs/v3.0.2/zephyr/soc/ti/simplelink/Kconfig"
osource "/home/jpandya/ncs/v3.0.2/zephyr/soc/ti/lm3s6965/Kconfig"
osource "/home/jpandya/ncs/v3.0.2/zephyr/soc/ti/k3/Kconfig"
osource "/home/jpandya/ncs/v3.0.2/zephyr/soc/telink/tlsr/Kconfig"
osource "/home/jpandya/ncs/v3.0.2/zephyr/soc/starfive/jh71xx/Kconfig"
osource "/home/jpandya/ncs/v3.0.2/zephyr/soc/st/stm32/Kconfig"
osource "/home/jpandya/ncs/v3.0.2/zephyr/soc/snps/qemu_arc/Kconfig"
osource "/home/jpandya/ncs/v3.0.2/zephyr/soc/snps/nsim/arc_v/Kconfig"
osource "/home/jpandya/ncs/v3.0.2/zephyr/soc/snps/nsim/arc_classic/Kconfig"
osource "/home/jpandya/ncs/v3.0.2/zephyr/soc/snps/hsdk4xd/Kconfig"
osource "/home/jpandya/ncs/v3.0.2/zephyr/soc/snps/hsdk/Kconfig"
osource "/home/jpandya/ncs/v3.0.2/zephyr/soc/snps/emsk/Kconfig"
osource "/home/jpandya/ncs/v3.0.2/zephyr/soc/snps/emsdp/Kconfig"
osource "/home/jpandya/ncs/v3.0.2/zephyr/soc/snps/arc_iot/Kconfig"
osource "/home/jpandya/ncs/v3.0.2/zephyr/soc/silabs/Kconfig"
osource "/home/jpandya/ncs/v3.0.2/zephyr/soc/sifive/sifive_freedom/Kconfig"
osource "/home/jpandya/ncs/v3.0.2/zephyr/soc/sensry/Kconfig"
osource "/home/jpandya/ncs/v3.0.2/zephyr/soc/rockchip/Kconfig"
osource "/home/jpandya/ncs/v3.0.2/zephyr/soc/renode/riscv_virtual/Kconfig"
osource "/home/jpandya/ncs/v3.0.2/zephyr/soc/renode/cortex_r8_virtual/Kconfig"
osource "/home/jpandya/ncs/v3.0.2/zephyr/soc/renesas/smartbond/Kconfig"
osource "/home/jpandya/ncs/v3.0.2/zephyr/soc/renesas/rzt2m/Kconfig"
osource "/home/jpandya/ncs/v3.0.2/zephyr/soc/renesas/rz/Kconfig"
osource "/home/jpandya/ncs/v3.0.2/zephyr/soc/renesas/rcar/Kconfig"
osource "/home/jpandya/ncs/v3.0.2/zephyr/soc/renesas/ra/Kconfig"
osource "/home/jpandya/ncs/v3.0.2/zephyr/soc/realtek/ec/Kconfig"
osource "/home/jpandya/ncs/v3.0.2/zephyr/soc/raspberrypi/rpi_pico/Kconfig"
osource "/home/jpandya/ncs/v3.0.2/zephyr/soc/quicklogic/eos_s3/Kconfig"
osource "/home/jpandya/ncs/v3.0.2/zephyr/soc/qemu/virt_riscv/Kconfig"
osource "/home/jpandya/ncs/v3.0.2/zephyr/soc/qemu/malta/Kconfig"
osource "/home/jpandya/ncs/v3.0.2/zephyr/soc/openisa/rv32m1/Kconfig"
osource "/home/jpandya/ncs/v3.0.2/zephyr/soc/nxp/s32/Kconfig"
osource "/home/jpandya/ncs/v3.0.2/zephyr/soc/nxp/rw/Kconfig"
osource "/home/jpandya/ncs/v3.0.2/zephyr/soc/nxp/mcx/Kconfig"
osource "/home/jpandya/ncs/v3.0.2/zephyr/soc/nxp/lpc/Kconfig"
osource "/home/jpandya/ncs/v3.0.2/zephyr/soc/nxp/layerscape/Kconfig"
osource "/home/jpandya/ncs/v3.0.2/zephyr/soc/nxp/kinetis/Kconfig"
osource "/home/jpandya/ncs/v3.0.2/zephyr/soc/nxp/imxrt/Kconfig"
osource "/home/jpandya/ncs/v3.0.2/zephyr/soc/nxp/imx/Kconfig"
osource "/home/jpandya/ncs/v3.0.2/zephyr/soc/nuvoton/numicro/Kconfig"
osource "/home/jpandya/ncs/v3.0.2/zephyr/soc/nuvoton/numaker/Kconfig"
osource "/home/jpandya/ncs/v3.0.2/zephyr/soc/nuvoton/npcx/Kconfig"
osource "/home/jpandya/ncs/v3.0.2/zephyr/soc/nuvoton/npcm/Kconfig"
osource "/home/jpandya/ncs/v3.0.2/zephyr/soc/nordic/Kconfig"
osource "/home/jpandya/ncs/v3.0.2/zephyr/soc/neorv32/Kconfig"
osource "/home/jpandya/ncs/v3.0.2/zephyr/soc/native/inf_clock/Kconfig"
osource "/home/jpandya/ncs/v3.0.2/zephyr/soc/microchip/miv/Kconfig"
osource "/home/jpandya/ncs/v3.0.2/zephyr/soc/microchip/mec/Kconfig"
osource "/home/jpandya/ncs/v3.0.2/zephyr/soc/mediatek/mt8xxx/Kconfig"
osource "/home/jpandya/ncs/v3.0.2/zephyr/soc/lowrisc/opentitan/Kconfig"
osource "/home/jpandya/ncs/v3.0.2/zephyr/soc/litex/litex_vexriscv/Kconfig"
osource "/home/jpandya/ncs/v3.0.2/zephyr/soc/ite/ec/Kconfig"
osource "/home/jpandya/ncs/v3.0.2/zephyr/soc/intel/raptor_lake/Kconfig"
osource "/home/jpandya/ncs/v3.0.2/zephyr/soc/intel/lakemont/Kconfig"
osource "/home/jpandya/ncs/v3.0.2/zephyr/soc/intel/intel_socfpga_std/Kconfig"
osource "/home/jpandya/ncs/v3.0.2/zephyr/soc/intel/intel_socfpga/Kconfig"
osource "/home/jpandya/ncs/v3.0.2/zephyr/soc/intel/intel_niosv/Kconfig"
osource "/home/jpandya/ncs/v3.0.2/zephyr/soc/intel/intel_ish/Kconfig"
osource "/home/jpandya/ncs/v3.0.2/zephyr/soc/intel/intel_adsp/Kconfig"
osource "/home/jpandya/ncs/v3.0.2/zephyr/soc/intel/elkhart_lake/Kconfig"
osource "/home/jpandya/ncs/v3.0.2/zephyr/soc/intel/atom/Kconfig"
osource "/home/jpandya/ncs/v3.0.2/zephyr/soc/intel/apollo_lake/Kconfig"
osource "/home/jpandya/ncs/v3.0.2/zephyr/soc/intel/alder_lake/Kconfig"
osource "/home/jpandya/ncs/v3.0.2/zephyr/soc/infineon/cat3/Kconfig"
osource "/home/jpandya/ncs/v3.0.2/zephyr/soc/infineon/cat1b/Kconfig"
osource "/home/jpandya/ncs/v3.0.2/zephyr/soc/infineon/cat1a/Kconfig"
osource "/home/jpandya/ncs/v3.0.2/zephyr/soc/gd/gd32/Kconfig"
osource "/home/jpandya/ncs/v3.0.2/zephyr/soc/gaisler/leon3/Kconfig"
osource "/home/jpandya/ncs/v3.0.2/zephyr/soc/gaisler/gr716a/Kconfig"
osource "/home/jpandya/ncs/v3.0.2/zephyr/soc/espressif/Kconfig"
osource "/home/jpandya/ncs/v3.0.2/zephyr/soc/ene/kb1200/Kconfig"
osource "/home/jpandya/ncs/v3.0.2/zephyr/soc/efinix/sapphire/Kconfig"
osource "/home/jpandya/ncs/v3.0.2/zephyr/soc/cdns/xtensa_sample_controller/Kconfig"
osource "/home/jpandya/ncs/v3.0.2/zephyr/soc/cdns/sample_controller32/Kconfig"
osource "/home/jpandya/ncs/v3.0.2/zephyr/soc/cdns/dc233c/Kconfig"
osource "/home/jpandya/ncs/v3.0.2/zephyr/soc/brcm/bcmvk/Kconfig"
osource "/home/jpandya/ncs/v3.0.2/zephyr/soc/brcm/bcm2712/Kconfig"
osource "/home/jpandya/ncs/v3.0.2/zephyr/soc/brcm/bcm2711/Kconfig"
osource "/home/jpandya/ncs/v3.0.2/zephyr/soc/atmel/sam0/Kconfig"
osource "/home/jpandya/ncs/v3.0.2/zephyr/soc/atmel/sam/Kconfig"
osource "/home/jpandya/ncs/v3.0.2/zephyr/soc/aspeed/Kconfig"
osource "/home/jpandya/ncs/v3.0.2/zephyr/soc/arm/Kconfig"
osource "/home/jpandya/ncs/v3.0.2/zephyr/soc/arm/beetle/Kconfig"
osource "/home/jpandya/ncs/v3.0.2/zephyr/soc/andestech/Kconfig"
osource "/home/jpandya/ncs/v3.0.2/zephyr/soc/amd/acp_6_0/Kconfig"
osource "/home/jpandya/ncs/v3.0.2/zephyr/soc/ambiq/Kconfig"
osource "/home/jpandya/ncs/v3.0.2/zephyr/soc/altr/zephyr_nios2f/Kconfig"
osource "/home/jpandya/ncs/v3.0.2/zephyr/soc/altr/qemu_nios2/Kconfig"
osource "/home/jpandya/ncs/v3.0.2/zephyr/soc/adi/max32/Kconfig"
osource "/home/jpandya/ncs/v3.0.2/nrf/soc/nordic/Kconfig"
```

## v1.1/app/pn5180/Kconfig
```kconfig
menuconfig PN5180
	bool "NXP PN5180 NFC Reader"
	depends on SPI
	depends on GPIO
	help
	  Enable driver for NXP PN5180 NFC reader IC.

if PN5180

config PN5180_INIT_PRIORITY
	int "PN5180 init priority"
	default 80
	help
	  PN5180 device driver initialization priority.

config PN5180_LOG_LEVEL
	int "PN5180 log level"
	default 3
	help
	  PN5180 driver log level.

endif # PN5180
```

## v1.1/app/pn5180/dts/bindings/nxp,pn5180.yaml
```yaml
description: NXP PN5180 NFC Reader

compatible: "nxp,pn5180"

include: spi-device.yaml

properties:
  irq-gpios:
    type: phandle-array
    required: true
    description: GPIO specifier for the IRQ pin

  rst-gpios:
    type: phandle-array
    required: true
    description: GPIO specifier for the reset pin

  busy-gpios:
    type: phandle-array
    required: true
    description: GPIO specifier for the busy pin

  nss-gpios:
    type: phandle-array
    required: true
    description: GPIO specifier for the chip select pin

  timeout-ms:
    type: int
    default: 1000
    description: Command timeout in milliseconds
```

## v1.1/app/ssd1683/Kconfig
```kconfig
menuconfig SSD1683
	bool "SSD1683 EPD Display Driver"
	depends on SPI
	depends on GPIO
	help
	  Enable driver for SSD1683 EPD display controller.
	  
	  The SSD1683 is a tri-color (black/white/red) EPD controller supporting
	  displays up to 400x300 pixels. This driver provides both low-level
	  control functions and a high-level device API.

if SSD1683

config SSD1683_INIT_PRIORITY
	int "SSD1683 init priority"
	default 80
	help
	  SSD1683 device driver initialization priority.

config SSD1683_LOG_LEVEL
	int "SSD1683 log level"
	default 3
	help
	  SSD1683 driver log level.

endif # SSD1683
```

## v1.1/app/ssd1683/drivers/ssd1683/Kconfig
```kconfig
config SSD1683
	bool "SSD1683 E-Paper Display Driver"
	default y
	depends on DT_HAS_SOLOMON_SSD1683_ENABLED
	depends on DISPLAY
	depends on SPI
	depends on GPIO
	help
	  Enable Zephyr display driver for Solomon SSD1683 E-Paper
	  display controller. This driver implements the Zephyr display
	  API and works with graphics frameworks like LVGL.
	  
	  The SSD1683 is a tri-color (black/white/red) EPD controller,
	  but this driver currently operates in monochrome mode only.

if SSD1683

config SSD1683_INIT_PRIORITY
	int "SSD1683 initialization priority"
	default 90
	help
	  Initialization priority for SSD1683 display driver.
	  Must be greater than SPI and GPIO priorities.
	  Default: 90 (after SPI at 70, before application at 99)

endif # SSD1683
```

## v1.1/app/ssd1683_next/drivers/ssd1683/Kconfig
```kconfig
config SSD1683
	bool "SSD1683 E-Paper Display Driver"
	default y
	depends on DT_HAS_SOLOMON_SSD1683_ENABLED
	depends on DISPLAY
	depends on SPI
	depends on GPIO
	help
	  Enable Zephyr display driver for the Solomon SSD1683 e-paper
	  controller. Implements the Zephyr display API with a shadow
	  framebuffer and dedicated workqueue so LVGL's per-region
	  flushes coalesce into one panel refresh.

if SSD1683

config SSD1683_INIT_PRIORITY
	int "SSD1683 initialization priority"
	default 90
	help
	  Initialization priority. Must be higher than SPI (70) and GPIO.

config SSD1683_FLUSH_DELAY_MS
	int "Coalesce LVGL tiles (ms)"
	default 20
	help
	  After display_write() stages pixels into the shadow FB, the driver
	  waits this many milliseconds before kicking the refresh. Each
	  additional write within the window expands the dirty rectangle and
	  re-arms the timer, so LVGL's N-flushes-per-frame become one refresh.

config SSD1683_PARTIAL_THRESHOLD_PCT
	int "Dirty area percent forcing full refresh"
	default 25
	range 1 100
	help
	  When the coalesced dirty rectangle covers at least this percentage
	  of the panel, use a full refresh instead of partial.

config SSD1683_PARTIAL_LIMIT
	int "Max partial refreshes before forced full"
	default 50
	help
	  E-paper panels accumulate ghosting after many partial updates.
	  Every N partials the driver performs a full refresh to wipe
	  the panel clean.

config SSD1683_WORKQUEUE_STACK_SIZE
	int "Driver workqueue stack size"
	default 2048

config SSD1683_WORKQUEUE_PRIORITY
	int "Driver workqueue thread priority"
	default 5
	help
	  Low priority is fine; the refresh takes hundreds of ms but
	  mostly sleeps inside _ssd1683_wait_busy.

config SSD1683_LOG_LEVEL
	int "SSD1683 driver log level"
	default 3
	help
	  Log level for the SSD1683 low-level driver (0=none, 4=debug).

endif # SSD1683
```

## zsk/lvgl_1/ssd1683/Kconfig
```kconfig
menuconfig SSD1683
	bool "SSD1683 EPD Display Driver"
	depends on SPI
	depends on GPIO
	help
	  Enable driver for SSD1683 EPD display controller.
	  
	  The SSD1683 is a tri-color (black/white/red) EPD controller supporting
	  displays up to 400x300 pixels. This driver provides both low-level
	  control functions and a high-level device API.

if SSD1683

config SSD1683_INIT_PRIORITY
	int "SSD1683 init priority"
	default 80
	help
	  SSD1683 device driver initialization priority.

config SSD1683_LOG_LEVEL
	int "SSD1683 log level"
	default 3
	help
	  SSD1683 driver log level.

config SSD1683_DEFAULT_FAST_MODE
	bool "Enable fast mode by default"
	default n
	help
	  Enable fast refresh mode by default for all SSD1683 displays.
	  Fast mode provides quicker updates but may have slightly reduced
	  image quality. Can be overridden per-device in device tree.

config SSD1683_SUPPORT_PARTIAL_REFRESH
	bool "Enable partial refresh support"
	default y
	help
	  Enable support for partial screen updates. This allows more
	  efficient updates when only part of the screen needs to change.

config SSD1683_SUPPORT_4GRAY_MODE
	bool "Enable 4-gray mode support"
	default y
	help
	  Enable support for 4-level grayscale display mode. This provides
	  better image quality but requires more complex image processing.

config SSD1683_SUPPORT_ROTATION
	bool "Enable display rotation support"
	default y
	help
	  Enable support for 180-degree display rotation. Useful for
	  displays that are mounted upside down.

endif # SSD1683
```

## zsk/lvgl_1/ssd1683/drivers/ssd1683/Kconfig
```kconfig
config SSD1683
	bool "SSD1683 EPD Display Driver"
	depends on DISPLAY
	depends on SPI
	depends on GPIO
	help
	  Enable driver for SSD1683 EPD display controller.

if SSD1683

config SSD1683_INIT_PRIORITY
	int "SSD1683 init priority"
	default 80
	help
	  SSD1683 device driver initialization priority.

config SSD1683_LOG_LEVEL
	int "SSD1683 log level"
	default 3
	help
	  SSD1683 driver log level.

endif # SSD1683
```
